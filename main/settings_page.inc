R"SETTINGS(<!doctype html><html lang="en"><head><meta charset="utf-8"><meta name="viewport" content="width=device-width,initial-scale=1"><title>Time Server · Settings</title><style>)SETTINGS"
#include "web_theme.inc"
R"SETTINGS(</style></head><body><main><header>)SETTINGS"
#include "web_brand.inc"
R"SETTINGS(<div class="header-side"><div class="edition">P4 OLED RACK EDITION</div><nav aria-label="Main navigation"><a href="/">Status</a><a href="/settings" aria-current="page">Settings</a></nav></div></header>
<div class="section-index">DEVICE MANAGEMENT</div><h2>Settings</h2><p class="settings-intro">Changes are saved on the ESP. Display settings apply immediately; the device name and network settings apply after a restart.</p>
<p class="warning">HTTPS uses this device’s local certificate. Verify its identity before signing in.</p>
<form id="login"><label for="login_password">Administrator password</label><input id="login_password" type="password" autocomplete="current-password" required maxlength="128"><button>Sign in</button></form>
<div id="notice" role="status" aria-live="polite"></div>
<div id="admin" hidden><div id="network_warning" class="warning" hidden>New network settings are active. Confirm them within two minutes of restarting, or the ESP will restore the previous configuration.<br><button type="button" id="confirm_network">Confirm network settings</button></div>
<form id="settings">
<fieldset><legend>Device and network</legend><label for="name">Device name</label><input id="name" maxlength="32" required pattern="[A-Za-z0-9-]+"><label><input id="dhcp" type="checkbox">Obtain an IP address automatically using DHCP</label><div class="fields"><div><label for="ip">Static IPv4 address</label><input id="ip" maxlength="15" placeholder="192.168.1.50"></div><div><label for="mask">Subnet mask</label><input id="mask" maxlength="15" placeholder="255.255.255.0"></div><div><label for="gateway">Gateway</label><input id="gateway" maxlength="15" placeholder="192.168.1.1"></div><div><label for="dns">DNS server (optional)</label><input id="dns" maxlength="15"></div></div><p class="hint">New network settings are tested after a restart. When changing the static IP, reopen this page at the new address.</p></fieldset>
<fieldset><legend>OLED</legend><div class="fields"><div><label for="brightness">Normal brightness (1-255)</label><input id="brightness" type="number" min="1" max="255" required></div><div><label for="dim_brightness">Dimmed brightness (1-255)</label><input id="dim_brightness" type="number" min="1" max="255" required></div><div><label for="dim_seconds">Dim after seconds (0 = never)</label><input id="dim_seconds" type="number" min="0" max="86400" required></div></div><p class="hint">Controller values, not percentages. The display stays on with the complete status screen.</p></fieldset>
<fieldset><legend>Access</legend><label for="password">New administrator password (optional)</label><input id="password" type="password" minlength="12" maxlength="128" autocomplete="new-password"><label for="password_repeat">Repeat new password</label><input id="password_repeat" type="password" maxlength="128" autocomplete="new-password"><p class="hint">At least 12 characters. Leave blank to keep the current password.</p></fieldset>
<button>Save</button><button class="secondary" type="button" id="reboot">Restart ESP</button><button class="secondary" type="button" id="logout">Sign out</button></form>
<fieldset><legend>Update firmware</legend><p>Select the matching <strong>ESP32TimeServer.bin</strong>, not a merged factory image. NTP reports an invalid time reference during updates. Keep power connected.</p><label for="firmware">Firmware file (.bin)</label><input id="firmware" type="file" accept=".bin"><button type="button" id="upload">Upload firmware and restart</button><p id="upload_status" role="status"></p></fieldset>
</div><p class="hint">Sessions last 15 minutes. An updated application confirms itself after 30 seconds if web management starts successfully. Otherwise, bootloader rollback applies on the next restart.</p>
</main><script>
const $=id=>document.getElementById(id);let token='';const texts=['name','ip','mask','gateway','dns'],numbers=['brightness','dim_brightness','dim_seconds'],bools=['dhcp'];
function notice(s){$('notice').textContent=s}function logout(){token='';$('login').hidden=false;$('admin').hidden=true;$('settings').reset();$('login_password').value=''}
async function api(path,body,timeout=8000){const ctrl=new AbortController(),timer=setTimeout(()=>ctrl.abort(),timeout);try{let r=await fetch('/api/'+path,{method:body===undefined?'GET':'POST',headers:{'Content-Type':'application/json','X-Admin-Token':token},body:body===undefined?undefined:JSON.stringify(body),signal:ctrl.signal,cache:'no-store'});let j=await r.json();if(!r.ok){if(r.status===401)logout();throw Error(j.error||'Request failed')}return j}finally{clearTimeout(timer)}}
function networkFields(){for(const id of ['ip','mask','gateway'])$(id).disabled=$('dhcp').checked}
async function load(){const c=await api('config');for(const id of [...texts,...numbers])$(id).value=c[id];for(const id of bools)$(id).checked=c[id];$('network_warning').hidden=!c.network_pending;networkFields()}
$('dhcp').onchange=networkFields;
$('login').onsubmit=async e=>{e.preventDefault();try{const j=await api('login',{password:$('login_password').value});token=j.token;$('login_password').value='';await load();$('login').hidden=true;$('admin').hidden=false;notice('Signed in.')}catch(err){notice(err.message)}};
$('settings').onsubmit=async e=>{e.preventDefault();if($('password').value!==$('password_repeat').value){notice('The new passwords do not match.');return}const c={};for(const id of texts)c[id]=$(id).value.trim();for(const id of numbers)c[id]=Number($(id).value);for(const id of bools)c[id]=$(id).checked;c.password=$('password').value;try{const result=await api('config',c);$('password').value='';$('password_repeat').value='';if(result.login_required){logout();notice('Saved. Sign in with the new password.')}else{await load();notice('Saved. Display settings are active. Restart to apply the device name or network settings.')}}catch(err){notice(err.message)}};
$('logout').onclick=async()=>{try{await api('logout',{})}catch(err){}logout();notice('Signed out.')};
$('reboot').onclick=async()=>{if(!confirm('Restart the ESP? NTP will be briefly unavailable.'))return;try{await api('reboot',{});logout();notice('Restart requested. Sign in again after about 30 seconds. If the IP changed, open the new address and confirm the network settings.')}catch(err){notice(err.message)}};
$('confirm_network').onclick=async()=>{try{await api('network-confirm',{});await load();notice('Network settings confirmed.')}catch(err){notice(err.message)}};
$('upload').onclick=async()=>{const file=$('firmware').files[0];if(!file||!file.name.endsWith('.bin')){notice('Select a .bin file.');return}if(!confirm('Install firmware and restart? NTP will not be reliably available during the update.'))return;$('upload').disabled=true;$('upload_status').textContent='Uploading. Do not disconnect power.';try{await new Promise((resolve,reject)=>{const xhr=new XMLHttpRequest();xhr.open('POST','/api/update');xhr.setRequestHeader('X-Admin-Token',token);xhr.setRequestHeader('Content-Type','application/octet-stream');xhr.timeout=180000;xhr.upload.onprogress=e=>{if(e.lengthComputable)$('upload_status').textContent='Uploaded: '+Math.round(e.loaded/e.total*100)+' % - firmware verification follows.'};xhr.onload=()=>xhr.status===200?resolve():reject(Error(JSON.parse(xhr.responseText).error||'Update failed'));xhr.onerror=()=>reject(Error('Network error. Check the ESP status.'));xhr.ontimeout=()=>reject(Error('Request timed out. Check the ESP status.'));xhr.send(file)});logout();notice('Firmware verified. The ESP is restarting; check its status afterwards.');$('upload_status').textContent='Update uploaded.'}catch(err){$('upload_status').textContent=err.message}finally{$('upload').disabled=false}};
</script></body></html>)SETTINGS"
